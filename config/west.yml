## config/west.yml
```yaml
manifest:
  remotes:
    - name: zmk
      url-base: https://github.com/zmkfirmware
    - name: yangxing
      url-base: https://github.com/yangxing844
  projects:
    - name: zmk
      remote: zmkfirmware
      revision: v0.3.0
      import: app/west.yml
    - name: zmk-tog-io
      remote: yangxing
      revision: master
  self:
    path: config
```
